## drivers/dma/sdxi/Kconfig
```kconfig
config SDXI
	tristate "SDXI support"
	default m
	select DMA_ENGINE
	select DMA_VIRTUAL_CHANNELS
	select PACKING
	help
	  Enable support for Smart Data Accelerator Interface (SDXI) DMA
	  controller. This controller provides DMA capabilities, plus other
	  advanced data processing features, that can offload the work for
	  CPUs.

config SDXI_DEBUG
	bool "SDXI driver debug"
	default DMADEVICES_DEBUG
	depends on SDXI != n
	help
	  Enable debug output from the SDXI driver.
```

## drivers/migoffcopy/Kconfig
```kconfig
config MTCOPY_CPU
       bool "Multi-Threaded Copy with CPU"
       depends on OFFC_MIGRATION
       default n
       help
         Enables a multi-threaded CPU-based offload engine for batch
         page migration. This can increase page copy throughput by
         parallelizing the copy operations.
```
